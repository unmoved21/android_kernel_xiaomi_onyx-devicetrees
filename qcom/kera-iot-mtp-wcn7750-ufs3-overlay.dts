// SPDX-License-Identifier: BSD-3-Clause
/*
 * Copyright (c) Qualcomm Technologies, Inc. and/or its subsidiaries.
 */

/dts-v1/;
/plugin/;

#include "kera-mtp-wcn7750-ufs3.dtsi"
#include "kera-pm7550ba.dtsi"

/ {
	model = "Qualcomm Technologies, Inc. Kera IoT MTP + WCN7750 + UFS3";
	compatible = "qcom,kera-mtp", "qcom,kera", "qcom,kerap-mtp", "qcom,kerap",
			"qcom,mtp", "qcom,kera-qmb", "qcom,kerap-qna";
	qcom,msm-id = <731 0x10000>, <732 0x10000>;
	qcom,board-id = <0x20008 1>;
};
