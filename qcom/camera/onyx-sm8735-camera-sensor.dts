/dts-v1/;
/plugin/;
#include <dt-bindings/clock/qcom,gcc-tuna.h>
#include <dt-bindings/clock/qcom,camcc-sun.h>
#include <dt-bindings/clock/qcom,cambistmclkcc-sun.h>
#include <dt-bindings/interconnect/qcom,tuna.h>
#include <dt-bindings/interrupt-controller/arm-gic.h>
#include <dt-bindings/regulator/qcom,rpmh-regulator-levels.h>
#include "onyx-sm8735-camera-sensor.dtsi"
/ {
	model = "Qualcomm Technologies, Inc. Tuna MTP";
	compatible = "qcom,tuna-mtp", "qcom,tuna", "qcom,tunap-mtp", "qcom,tunap", "qcom,mtp";
        qcom,msm-id = <655 0x10000>, <655 0x20000>, <681 0x10000>, <681 0x20000>,
			<694 0x10000>, <694 0x20000>;
	qcom,board-id = <8 0>;
	xiaomi,miboard-id = <0x7 0>;
};
