// SPDX-License-Identifier: BSD-3-Clause
/*
 * Copyright (c) Qualcomm Technologies, Inc. and/or its subsidiaries.
 */

/dts-v1/;
/plugin/;

#include <dt-bindings/interrupt-controller/arm-gic.h>
#include <dt-bindings/clock/qcom,gcc-sun.h>
#include <dt-bindings/interconnect/qcom,sun.h>
#include <dt-bindings/clock/qcom,videocc-sun.h>
#include "sun-vidc-v3.dtsi"

/ {
	model = "Qualcomm Technologies, Inc. Sun";
	compatible = "qcom,sun";
	qcom,msm-id = <705 0x20000>, <706 0x20000>,
	              <0x10002c1 0x20000>, <0x10002c2 0x20000>;
	qcom,board-id = <0 0>;
};
