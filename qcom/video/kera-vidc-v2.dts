// SPDX-License-Identifier: BSD-3-Clause
/*
 * Copyright (c) Qualcomm Technologies, Inc. and/or its subsidiaries.
 */
/dts-v1/;
/plugin/;

#include <dt-bindings/interrupt-controller/arm-gic.h>
#include <dt-bindings/clock/qcom,gcc-kera.h>
#include <dt-bindings/interconnect/qcom,kera.h>
#include <dt-bindings/clock/qcom,videocc-tuna.h>
#include "kera-vidc-v2.dtsi"

/ {
	model = "Qualcomm Technologies, Inc. kera";
	compatible = "qcom,kera";
	qcom,msm-id = <731 0x10000>, <732 0x10000>;
	qcom,board-id = <0 0>;
};
