// SPDX-License-Identifier: BSD-3-Clause
/*
 * Copyright (c) Qualcomm Technologies, Inc. and/or its subsidiaries.
 */

/dts-v1/;
/plugin/;

#include "kera-audio-evk-wcd9378-dmic.dtsi"
/ {
	model = "Qualcomm Technologies, Inc. Kuna EVK WCD9378 + DMIC";
	compatible = "qcom,kera-evk", "qcom,kera", "qcom,kerap-evk", "qcom,kerap",
			"qcom,evk";
	qcom,msm-id = <731 0x10000>, <732 0x10000>;
	qcom,board-id = <0x1002F 0>, <0x2002F 0>;
};
