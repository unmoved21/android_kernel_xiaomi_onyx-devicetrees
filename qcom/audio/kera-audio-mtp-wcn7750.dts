// SPDX-License-Identifier: BSD-3-Clause
/*
 * Copyright (c) Qualcomm Technologies, Inc. and/or its subsidiaries.
 */

/dts-v1/;
/plugin/;

#include "kera-audio-mtp-wcn7750.dtsi"

/ {
	model = "Qualcomm Technologies, Inc. Kera MTP + WCN7750 (ORNE)";
	compatible = "qcom,kera-mtp", "qcom,kera", "qcom,kerap-mtp", "qcom,kerap",
			"qcom,mtp", "qcom,kera-qmb", "qcom,kerap-qna";
	qcom,msm-id = <686 0x10000>, <659 0x10000>, <731 0x10000>, <732 0x10000>, <720 0x10000>, <721 0x10000>;
	qcom,board-id = <0x10008 1>, <0x20008 1>;
};
