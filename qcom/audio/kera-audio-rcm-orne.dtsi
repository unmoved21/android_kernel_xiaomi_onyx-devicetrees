// SPDX-License-Identifier: BSD-3-Clause
/*
 * Copyright (c) Qualcomm Technologies, Inc. and/or its subsidiaries.
 */

/dts-v1/;
/plugin/;

#include "kera-audio-cdp.dtsi"

&lpass_bt_swr {
	status = "okay";
};

&kera_snd {
	qcom,wcn-bt = <1>;
};
