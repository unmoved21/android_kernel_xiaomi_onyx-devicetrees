// SPDX-License-Identifier: BSD-3-Clause
/*
 * Copyright (c) Qualcomm Technologies, Inc. and/or its subsidiaries.
 */

/dts-v1/;
/plugin/;

#include "kera-sde-display-rcm-no-display.dtsi"

/ {
	model = "Qualcomm Technologies, Inc. No Display Kera RCM";
	compatible = "qcom,kera-rcm", "qcom,kera", "qcom,kerap-rcm", "qcom,kerap",
			"qcom,rcm";
	qcom,msm-id = <731 0x10000>, <732 0x10000>;
	qcom,board-id = <0x10015 2>, <0x20015 2>, <0x30015 2>;
};
