// SPDX-License-Identifier: BSD-3-Clause
/*
 * Copyright (c) Qualcomm Technologies, Inc. and/or its subsidiaries.
 */

#include "montague-hsp.dtsi"

&pcie0 {
	status = "disabled";
};

&pcie0_msi {
	status = "disabled";
};
