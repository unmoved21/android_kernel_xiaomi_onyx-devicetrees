// SPDX-License-Identifier: BSD-3-Clause

/*
 * Copyright (c) Qualcomm Technologies, Inc. and/or its subsidiaries.
 */

/dts-v1/;
/plugin/;

#include "ravelin-qca6490-cnss.dtsi"
/ {
	model = "Qualcomm Technologies, Inc. Montague FP1/FP3 HSP IDP";
	compatible = "qcom,montague-idp", "qcom,montague", "qcom,idp";
	qcom,msm-id = <773 0x10000>, <774 0x10000>;
	qcom,board-id = <0x10022 0x4>, <0x10022 0xA>;
	qcom,softsku-id = <1>, <3>;
};
