// SPDX-License-Identifier: BSD-3-Clause
/*
 * Copyright (c) Qualcomm Technologies, Inc. and/or its subsidiaries.
 */

/dts-v1/;
/plugin/;

#include "waipio-kiwi-cnss.dtsi"

/ {
	model = "Qualcomm Technologies, Inc. Waipio with Kiwi";
	compatible = "qcom,waipio";
	qcom,msm-id = <457 0x10000>, <482 0x10000>, <457 0x20000>, <482 0x20000>, <552 0x10000>;
	qcom,board-id =  <0x02010001 0x2>, <0x04010008 0x04>, <0x02010008 0>;
};
