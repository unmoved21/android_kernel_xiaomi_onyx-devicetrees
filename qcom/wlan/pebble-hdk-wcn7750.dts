// SPDX-License-Identifier: BSD-3-Clause
/*
 * Copyright (c) Qualcomm Technologies, Inc. and/or its subsidiaries.
 */

/dts-v1/;
/plugin/;

#include "pebble-wcn7750.dtsi"

/ {
	model = "Qualcomm Technologies, Inc. Pebble HDK + wcn7750 WLAN";
	compatible = "qcom,pebble-hdk", "qcom,pebblep-hdk", "qcom,hdk", "qcom,pebble", "qcom,pebblep";
	qcom,msm-id = <735 0x10000>, <735 0x10001>, <741 0x10000>, <741 0x10001>, <793 0x10000>, <794 0x10000>;
	qcom,board-id = <0x1001f 0x0>;
};
