// SPDX-License-Identifier: BSD-3-Clause
/*
 * Copyright (c) Qualcomm Technologies, Inc. and/or its subsidiaries.
 */

/dts-v1/;
/plugin/;

#include "coast-qca6750.dtsi"

/ {
	model = "Qualcomm Technologies, Inc. Coast QRD + LP5 + QCA6750 + UFS4.1";
	compatible = "qcom,coast-qrd", "qcom,qrd", "qcom,coast";
	qcom,msm-id = <761 0x10000>;
	qcom,board-id = <0x2000b 0x0>;
};
