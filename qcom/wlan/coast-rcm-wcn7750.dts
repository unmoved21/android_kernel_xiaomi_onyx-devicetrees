// SPDX-License-Identifier: BSD-3-Clause
/*
 * Copyright (c) Qualcomm Technologies, Inc. and/or its subsidiaries.
 */

/dts-v1/;
/plugin/;

#include "coast-wcn7750.dtsi"

/ {
	model = "Qualcomm Technologies, Inc. Coast RCM + LP5 + LP4 + WCN7750 + UFS4.1";
	compatible = "qcom,coast-rcm", "qcom,rcm", "qcom,coast";
	qcom,msm-id = <761 0x10000>;
	qcom,board-id = <0x10015 0x0>, <0x10115 0x0>;
};
