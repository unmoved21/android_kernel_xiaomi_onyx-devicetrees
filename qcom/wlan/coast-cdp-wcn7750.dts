// SPDX-License-Identifier: BSD-3-Clause
/*
 * Copyright (c) Qualcomm Technologies, Inc. and/or its subsidiaries.
 */

/dts-v1/;
/plugin/;

#include "coast-wcn7750.dtsi"

/ {
	model = "Qualcomm Technologies, Inc. Coast CDP + LP5 + WCN7750 + UFS4.1";
	compatible = "qcom,coast-cdp", "qcom,cdp", "qcom,coast";
	qcom,msm-id = <761 0x10000>;
	qcom,board-id = <0x10001 0x0>;
};
