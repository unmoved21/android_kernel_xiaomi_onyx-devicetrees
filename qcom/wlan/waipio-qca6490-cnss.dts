// SPDX-License-Identifier: BSD-3-Clause
/*
 * Copyright (c) Qualcomm Technologies, Inc. and/or its subsidiaries.
 */

/dts-v1/;
/plugin/;

#include "waipio-qca6490-cnss.dtsi"

/ {
	model = "Qualcomm Technologies, Inc. Waipio with QCA6490";
	compatible = "qcom,waipio";
	qcom,msm-id = <457 0x10000>, <482 0x10000>, <457 0x20000>, <482 0x20000>, <552 0x10000>;
	qcom,board-id =  <33 0>, <0x10021 0>, <1 0>, <0x10001 0>, <0x10001 3>, <0x10001 4>,
			<0x01010001 0x1>, <0x01010008 0x1>, <0x1000b 0>, <0x10008 0>, <0x03010008 0x03>,
			<0x10008 5>, <0x10008 6>, <0x10008 7>, <0x2000b 0>, <8 0>, <11 0>, <15 0>,
			<0x1001f 0>, <0x1000F 0>;
};
