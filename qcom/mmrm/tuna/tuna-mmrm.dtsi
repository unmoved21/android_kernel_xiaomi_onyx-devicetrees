// SPDX-License-Identifier: BSD-3-Clause
/*
 * Copyright (c) 2024 Qualcomm Innovation Center, Inc. All rights reserved.
 */

&soc {
	msm_mmrm: qcom,mmrm {
		compatible = "qcom,msm-mmrm", "qcom,tuna-mmrm";
		status = "okay";

		/* MMRM clock threshold */
		mmrm-peak-threshold = <10000>;

		/* MM Rail info */
		mm-rail-corners = "lowsvs", "svs", "svsl1", "nom", "noml1", "turbo";
		mm-rail-fact-volt = <35652 41157 44827 47711 50332 52429>;

		/* Scaling factors */
		scaling-fact-dyn = <36045 49152 58983 67503 75367 82576>;
		scaling-fact-leak = <844760 1055785 1215038 1353974 1492911 1616118>;

		/* Client info */
		mmrm-client-info =
			<0x1 CAM_CC_CAMNOC_RT_AXI_CLK_SRC	4459070		263455	1>,
			<0x1 CAM_CC_CSID_CLK_SRC		1795032		131072	3>,
			<0x1 CAM_CC_ICP_0_CLK_SRC		353895		17040	1>,
			<0x1 CAM_CC_ICP_1_CLK_SRC		253232		17040	1>,
			<0x1 CAM_CC_IFE_LITE_CLK_SRC		383386		418120	2>,
			<0x1 CAM_CC_IPE_NPS_CLK_SRC		35389440	409600	1>,
			<0x1 CAM_CC_JPEG_CLK_SRC		770048		26870	4>,
			<0x1 CAM_CC_OFE_CLK_SRC			41680896	418120	1>,
			<0x1 CAM_CC_TFE_0_CLK_SRC		22514893	312607	1>,
			<0x1 CAM_CC_TFE_1_CLK_SRC		22514893	312607	1>,
			<0x1 CAM_CC_TFE_2_CLK_SRC		22514893	312607	1>,
			<0x1 CAM_CC_FAST_AHB_CLK_SRC		32768		6554	1>,
			<0x1 CAM_CC_SLOW_AHB_CLK_SRC		58983		11797	1>,
			<0x1 CAM_CC_CCI_0_CLK_SRC		0		656	1>,
			<0x1 CAM_CC_CCI_1_CLK_SRC		0		656	1>,
			<0x1 CAM_CC_CCI_2_CLK_SRC		0		656	1>,
			<0x1 CAM_CC_CRE_CLK_SRC			65536		1967	1>,
			<0x1 CAM_CC_CSI0PHYTIMER_CLK_SRC	6554		0	1>,
			<0x1 CAM_CC_CSI1PHYTIMER_CLK_SRC	6554		0	1>,
			<0x1 CAM_CC_CSI2PHYTIMER_CLK_SRC	6554		0	1>,
			<0x1 CAM_CC_CSI3PHYTIMER_CLK_SRC	6554		0	1>,
			<0x1 CAM_CC_CSI4PHYTIMER_CLK_SRC	6554		0	1>,
			<0x1 CAM_CC_CSI5PHYTIMER_CLK_SRC	6554		0	1>,
			<0x1 CAM_CC_CPHY_RX_CLK_SRC		19661		33424	10>,
			<0x1 CAM_CC_IFE_LITE_CSID_CLK_SRC	492831		24249	2>,

			<0x2 EVA_CC_MVS0_CLK_SRC		3723822		105513	1>,
			<0x3 DISP_CC_MDSS_MDP_CLK_SRC		16117269	346686	1>,
			<0x4 VIDEO_CC_MVS0_CLK_SRC		727974		8127	1>;
	};
};
