// SPDX-License-Identifier: BSD-3-Clause
/*
 * Copyright (c) Qualcomm Technologies, Inc. and/or its subsidiaries.
 */

/dts-v1/;
/plugin/;

#include "kera-ese-common.dtsi"

/ {
	model = "Qualcomm Technologies, Inc. Kera EVK + eMMC";
	compatible = "qcom,kera-evk", "qcom,kera", "qcom,kerap-evk", "qcom,kerap",
			"qcom,evk";
	qcom,msm-id = <731 0x10000>, <732 0x10000>;
	qcom,board-id = <0x1002F 0>, <0x2002F 0>, <0x3002F 0>, <0x4002F 0>, <0x5002F 0>, <0x6002F 0>, <0x7002F 0>;
};

