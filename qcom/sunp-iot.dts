// SPDX-License-Identifier: BSD-3-Clause
/*
 * Copyright (c) Qualcomm Technologies, Inc. and/or its subsidiaries.
 */

/dts-v1/;

#include "sunp-iot.dtsi"

/ {
	model = "Qualcomm Technologies, Inc. SunP CQ8750S SoC";
	compatible = "qcom,sunp";
	qcom,board-id = <0 0>;
};
