// SPDX-License-Identifier: BSD-3-Clause
/*
 * Copyright (c) Qualcomm Technologies, Inc. and/or its subsidiaries.
 */

#include "sun-vm.dtsi"

/ {
	model = "Qualcomm Technologies, Inc. SunP VM";
	compatible = "qcom,sunp";
	qcom,msm-id = <639 0x10000>, <639 0x20000>, <705 0x10000>, <705 0x20000>;
};

