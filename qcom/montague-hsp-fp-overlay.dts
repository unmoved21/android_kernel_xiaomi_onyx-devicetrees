// SPDX-License-Identifier: BSD-3-Clause
/*
 * Copyright (c) Qualcomm Technologies, Inc. and/or its subsidiaries.
 */

/dts-v1/;
/plugin/;

#include "montague-hsp.dtsi"

/ {
	model = "Qualcomm Technologies, Inc. Montague HSP FP1/FP3 IDP";
	compatible = "qcom,montague-idp", "qcom,montague", "qcom,idp", "qcom,montague-qmb";
	qcom,msm-id = <773 0x10000>, <774 0x10000>;
	qcom,board-id = <0x10022 0x4>;
	qcom,softsku-id = <1>, <3>;
};

&pcie0 {
	qcom,config-recovery;
	qcom,drv-supported;
};

